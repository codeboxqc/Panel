#include <string.h>
#include <Arduino.h>
#include <ESP32-HUB75-MatrixPanel-I2S-DMA.h>
#include <math.h>

#include <stdint.h>  // For uint16_t, int16_t, etc.
#include "gfx.h"
// Define panel dimensions
 
#include <string.h>
#include <stdint.h>  // For uint16_t, int16_t, etc.

// Define panel dimensions
 
#define NUMPTS 256
#define MAXDIAM 198
#define FRAMESPERCFG 350
#define ANGLEDIVISOR 6

 

// Cosine table from COSTBL.INC (signed 16-bit values)
static const int16_t CosTbl2[1024] = {
    32767, 32766, 32765, 32761, 32757, 32752, 32745, 32737, 32728, 32717, 32705, 32692,
    32678, 32663, 32646, 32628, 32609, 32589, 32567, 32545, 32521, 32495, 32469, 32441,
    32412, 32382, 32351, 32318, 32285, 32250, 32213, 32176, 32137, 32098, 32057, 32014,
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    32757, 32761, 32765, 32766
};

 

// Configuration structure
typedef struct {
    uint16_t phi, alp, rho;
    int16_t incphi, incalp, incrho, gapphi, gapalp;
    uint16_t sizeh, sizev;
    uint16_t color_r, color_g, color_b;  // Added color per preset
} Config2;

// DIVERSE PRESETS - Each looks completely different
static const Config2 presets2[28] = {
    // 1. Classic rotating globe (balanced)
    {56000, 6000, 48600, 400, 120, 100, -1200, 1200, 197, 197},

    // 2. Flat 2D spiral disc
    {17500, 64000, 18000, 400, 100, -80, -200, -2200, 197, 197},

    // 3. Dense star cluster (chaotic)
    {25900, 32500, 23600, -40, -320, -60, -1800, -500, 198, 255},

    // 4. Wireframe cube illusion
    {45500, 47200, 57600, -200, -200, -160, -1800, -600, 198, 0},

    // 5. Smooth cylinder
    {3000, 2600, 2800, 420, 100, 380, 100, 460, 197, 197},

    // 6. Meteor rain (fast streaks)
    {7600, 41200, 53800, -300, -100, 0, -20, -3400, 198, 0},

    // 7. Donut torus
    {35000, 55000, 41900, -180, -360, -100, -4900, -800, 198, 198},

    // 8. Rotating diamond sheet
    {6500, 42400, 50300, -20, -300, -50, -2300, -470, 198, 80},

    // 9. Double helix (DNA feel)
    {600, 60000, 53800, -120, -90, 0, -800, -3400, 198, 255},

    // 10. Galaxy swirl (arms expanding)
    {10100, 53700, 58400, -160, 260, 0, -60, -6000, 198, 198},

    // 11. Chaotic explosion
    {41400, 18500, 53800, -120, -80, 0, -1200, -3400, 198, 0},

    // 12. Ribbon wave (snake-like)
    {3800, 26500, 63300, 2200, -700, 0, -900, -1100, 198, 0},

    // 13. Starburst ring
    {49400, 200, 31300, -80, -80, 480, -260, -260, 197, 197},

    // 14. Flat plasma sheet
    {0, 47800, 10800, 0, 120, 100, 300, -4500, 198, 198},

    // 15. Chaotic field
    {63700, 25500, 53800, 60, -10, 0, -4000, -2000, 198, 0},

    // 16. Helix corkscrew
    {30700, 2100, 51800, 60, -10, 300, -4000, -1200, 198, 86},

    // 17. Rotating cube lattice
    {40500, 24600, 100, 1600, -600, 0, -760, -380, 198, 178},

    // 18. Expanding pulse disc
    {39300, 54800, 23800, 200, 160, 0, -3500, -1200, 198, 178},

        // 19. Deep Ocean Sphere (dark navy globe)
    {12200, 31500, 41000, 300, 200, 0, -2000, -1800, 50, 100},  

    // 20. Electric Blue Spiral
    {18500, 49500, 26500, 400, -600, 120, -2600, -300, 120, 255},  

    // 21. Plasma Ring (cyan pulse)
    {22200, 27500, 38900, -180, -220, -60, -3200, -900, 80, 180},  

    // 22. Aqua Helix (DNA swirl)
    {31500, 42000, 50700, 200, -300, 140, -2800, -1600, 60, 200},  

    // 23. Frozen Wave Sheet
    {6400, 29000, 57500, 1600, -400, 0, -1500, -600, 40, 160},  

    // 24. Nebula Cloud (chaotic scatter, teal glow)
    {41500, 38500, 29200, -300, -500, 0, -4200, -2100, 100, 220},  

    // 25. Blue Comet Trails
    {9500, 21000, 36000, 800, -200, 400, -1200, -3400, 90, 180},  

    // 26. Ice Cube Rotation
    {28000, 37000, 44000, -260, -180, -200, -2000, -2600, 70, 150},  

    // 27. Cosmic Whirlpool (dark-to-bright blue arms)
    {12500, 26500, 58500, -120, 320, 0, -500, -4800, 50, 255},  

    // 28. Arctic Starburst
    {37500, 30500, 42200, 2000, -600, 0, -1800, -300, 30, 120}

};





 

// Draw the globe points directly to the buffer (adapted for 64x64)
void drawGlobe2(Config2 *cfg) {
    uint16_t _phi = cfg->phi;
    uint16_t _alp = cfg->alp;
    uint16_t _rho = cfg->rho;
    uint16_t color = fastRGB565(1, 1, 254);

    for (int i = 0; i < NUMPTS; i++) {
        int16_t ax, dx;
        uint16_t bx;
        int32_t prod;

        // Compute X
        bx = _alp;
        dx = getCos(bx);
        bx = _phi;
        ax = getCos(bx);
        prod = (int32_t)ax * dx;
        dx = prod >> 16;
        dx <<= 1;
        ax = cfg->sizeh;
        prod = (int32_t)ax * dx;
        dx = prod >> 16;
        int orig_x = dx + 160;
        int x = (orig_x - 160) / 5 + 32;

        // Compute Y first term
        bx = _phi;
        dx = getSin(bx);
        bx = _rho;
        ax = getCos(bx);
        prod = (int32_t)ax * dx;
        dx = prod >> 16;
        dx <<= 1;
        ax = cfg->sizev;
        prod = (int32_t)ax * dx;
        dx = prod >> 16;
        int y = dx;

        // Compute Y second term
        bx = _alp;
        dx = getSin(bx);
        bx = _phi;
        ax = getCos(bx);
        prod = (int32_t)ax * dx;
        dx = prod >> 16;
        dx <<= 1;
        bx = _rho;
        ax = getSin(bx);
        prod = (int32_t)ax * dx;
        dx = prod >> 16;
        dx <<= 1;
        ax = cfg->sizeh;
        prod = (int32_t)ax * dx;
        dx = prod >> 16;
        y += dx;
        y += 101;
        int scaled_y = ((y - 101) * 8) / 25 + 32;

        // Draw if in bounds
        if (x >= 0 && x < WIDTH && scaled_y >= 0 && scaled_y < HEIGHT) {
            setBufferPixel(x, scaled_y, color);
        }

        // Increment angles for next point
        _alp += cfg->gapalp;
        _phi += cfg->gapphi;
    }
}

// Sequence handling (opening/closing presets)
static void doSequence2(Config2 *cfg, int *state, int *chngDiameter, uint16_t *chngDH, uint16_t *chngDV, int *preset_index) {
    int ax = *state;
    if (ax == 0) {
        (*chngDiameter)++;
        if (*chngDiameter == MAXDIAM) {
            (*state)++;
        }
    } else if (ax == FRAMESPERCFG) {
        (*chngDiameter)--;
        if (*chngDiameter == 0) {
            *state = 0;
            (*preset_index)++;
            
            // Optional: Add some randomness to preset order
            if (random(100) > 80) {  // 20% chance to jump randomly
                *preset_index = random(28);
            }
            
            *cfg = presets2[(*preset_index) % 28];
            *chngDH = cfg->sizeh;
            *chngDV = cfg->sizev;
        }
    } else {
        (*state)++;
    }

    // Update sizes during open/close
    if (*state == 0 || *state == FRAMESPERCFG) {
        int diam = *chngDiameter;
        cfg->sizeh = (uint16_t)((int32_t)diam * *chngDH / MAXDIAM);
        cfg->sizev = (uint16_t)((int32_t)diam * *chngDV / MAXDIAM);
    }
}





// Global variables for animation state
Config2 actual2 = presets2[0];
int preset_index2 = 0;
uint16_t chngDH2 = actual2.sizeh;
uint16_t chngDV2 = actual2.sizev;
int chngDiameter2 = 0;
int state2 = 0;

// Main globe animation function
void glob2() {
    clearTextBuffer();
    drawGlobe2(&actual2);
    pageFlip();

    // Update angles
    actual2.phi += actual2.incphi;
    actual2.alp += actual2.incalp;
    actual2.rho += actual2.incrho;

    // Handle sequence (non-interactive)
    doSequence2(&actual2, &state2, &chngDiameter2, &chngDH2, &chngDV2, &preset_index2);
}
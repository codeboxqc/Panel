#include <string.h>
#include <Arduino.h>
#include <ESP32-HUB75-MatrixPanel-I2S-DMA.h>
#include <math.h>

#include <stdint.h>  // For uint16_t, int16_t, etc.
#include "gfx.h"
// Define panel dimensions
 
#define NUMPTS 256
#define MAXDIAM 198
#define FRAMESPERCFG 350
#define ANGLEDIVISOR 6

 

// Double buffer system
 
 

// Cosine table from COSTBL.INC (signed 16-bit values)
static const int16_t CosTbl[1024] = {
    32767, 32766, 32765, 32761, 32757, 32752, 32745, 32737, 32728, 32717, 32705, 32692,
    32678, 32663, 32646, 32628, 32609, 32589, 32567, 32545, 32521, 32495, 32469, 32441,
    32412, 32382, 32351, 32318, 32285, 32250, 32213, 32176, 32137, 32098, 32057, 32014,
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    32757, 32761, 32765, 32766
};

// Cos and Sin functions
 int16_t getCos(uint16_t angle) {
    uint16_t idx = angle >> ANGLEDIVISOR;
    idx &= 1023;
    return CosTbl[idx];
}

  int16_t getSin(uint16_t angle) {
    return getCos(angle + 0x4000);  // 90 degrees shift
}

// Configuration structure
typedef struct {
    uint16_t phi, alp, rho;
    int16_t incphi, incalp, incrho, gapphi, gapalp;
    uint16_t sizeh, sizev;
} Config;

// Preset configurations from GLOBECFG.INC
static const Config presets[18] = {
    {55904, 5896, 48640, 424, 96, 112, -24, 24, 197, 197},
    {17512, 63976, 18136, 424, 96, -80, -24, -224, 197, 197},
    {25872, 32504, 23584, -24, -312, -48, -1896, -464, 198, 198},
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    {39344, 54824, 23824, 192, 152, 0, -3456, -1240, 198, 178}
};

 
 
 

// Draw the globe points directly to the buffer (adapted for 64x64)
void drawGlobe(Config *cfg) {
    uint16_t _phi = cfg->phi;
    uint16_t _alp = cfg->alp;
    uint16_t _rho = cfg->rho;
    uint16_t color = fastRGB565(255, 0, 0);

    for (int i = 0; i < NUMPTS; i++) {
        int16_t ax, dx;
        uint16_t bx;
        int32_t prod;

        // Compute X
        bx = _alp;
        dx = getCos(bx);
        bx = _phi;
        ax = getCos(bx);
        prod = (int32_t)ax * dx;
        dx = prod >> 16;
        dx <<= 1;
        ax = cfg->sizeh;
        prod = (int32_t)ax * dx;
        dx = prod >> 16;
        int orig_x = dx + 160;
        int x = (orig_x - 160) / 5 + 32;

        // Compute Y first term
        bx = _phi;
        dx = getSin(bx);
        bx = _rho;
        ax = getCos(bx);
        prod = (int32_t)ax * dx;
        dx = prod >> 16;
        dx <<= 1;
        ax = cfg->sizev;
        prod = (int32_t)ax * dx;
        dx = prod >> 16;
        int y = dx;

        // Compute Y second term
        bx = _alp;
        dx = getSin(bx);
        bx = _phi;
        ax = getCos(bx);
        prod = (int32_t)ax * dx;
        dx = prod >> 16;
        dx <<= 1;
        bx = _rho;
        ax = getSin(bx);
        prod = (int32_t)ax * dx;
        dx = prod >> 16;
        dx <<= 1;
        ax = cfg->sizeh;
        prod = (int32_t)ax * dx;
        dx = prod >> 16;
        y += dx;
        y += 101;
        int scaled_y = ((y - 101) * 8) / 25 + 32;

        // Draw if in bounds
        if (x >= 0 && x < WIDTH && scaled_y >= 0 && scaled_y < HEIGHT) {
           // color = fastRGB565(0, 0, 200+scaled_y);
            setBufferPixel(x, scaled_y, color);
        }

        // Increment angles for next point
        _alp += cfg->gapalp;
        _phi += cfg->gapphi;
    }
}

// Sequence handling (opening/closing presets)
static void doSequence(Config *cfg, int *state, int *chngDiameter, uint16_t *chngDH, uint16_t *chngDV, int *preset_index) {
    int ax = *state;
    if (ax == 0) {
        (*chngDiameter)++;
        if (*chngDiameter == MAXDIAM) {
            (*state)++;
        }
    } else if (ax == FRAMESPERCFG) {
        (*chngDiameter)--;
        if (*chngDiameter == 0) {
            *state = 0;
            (*preset_index)++;
            *cfg = presets[(*preset_index) % 18];
            *chngDH = cfg->sizeh;
            *chngDV = cfg->sizev;
        }
    } else {
        (*state)++;
    }

    // Update sizes during open/close
    if (*state == 0 || *state == FRAMESPERCFG) {
        int diam = *chngDiameter;
        cfg->sizeh = (uint16_t)((int32_t)diam * *chngDH / MAXDIAM);
        cfg->sizev = (uint16_t)((int32_t)diam * *chngDV / MAXDIAM);
    }
}


  Config actual = presets[0];
    int preset_index = 0;
    uint16_t chngDH = actual.sizeh;
    uint16_t chngDV = actual.sizev;
    int chngDiameter = 0;
    int state = 0;

// Main loop (assume this is in your setup/main function, replace delay with actual timing)
void glob() {  // Or integrate into your embedded main/loop
   

  

  //  while (1) {  // Infinite loop for animation
        clearTextBuffer();
        drawGlobe(&actual);
        pageFlip();

        // Update angles
        actual.phi += actual.incphi;
        actual.alp += actual.incalp;
        actual.rho += actual.incrho;

        // Handle sequence (non-interactive)
        doSequence(&actual, &state, &chngDiameter, &chngDH, &chngDV, &preset_index);

        // Add delay for frame rate (adjust based on your system, e.g., for 60 FPS)
        // delay(16);  // Pseudocode, replace with actual delay function
  //  }
}